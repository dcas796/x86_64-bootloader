#include <memory_map.h>

ENTRY(_start)
/* OUTPUT_FORMAT("binary") */

SECTIONS {
    . = STAGE0_PHY_ADDR;

    .bpb : {
        *(.bpb*)
    }

    . = STAGE0_PHY_ADDR + 90;

    .text : {
        *(.text*)
    }

    .rodata : {
        *(.rodata*)
    }

    .bss : {
        *(.bss*)
        *(COMMON)
    }

    .data : {
        *(.data*)
    }

    stack_bottom = .;
    . = STAGE0_END - 2;
    stack_top = .;

    .magic : {
        *(.magic*)
    }
}
